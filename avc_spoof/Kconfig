## avc_spoof/Kconfig
```kconfig
menu "AVC SPOOF"

config SELINUX_AVC_SPOOF
	tristate "AVC SPOOF"
	default m
	help
	  a small demo of lkm_template.
	  all this does is try spoof su sid on audit logs.

config SELINUX_AVC_SPOOF_USE_CFI
    bool "Enable CFI-compatible build (for CONFIG_CFI_CLANG kernels)"
    default y if CFI_CLANG
    help
      Enable this to build AVC spoof module with Clang CFI flags.

endmenu
```
